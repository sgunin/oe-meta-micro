## conf/distro/micro-x11.conf
```bitbake
# Based on the Micro Linux distribution
require conf/distro/micro.conf

# Use overrides for micro as well
OVERRIDES .= ":micro"

DISTRO_FEATURES += "x11"
```

## conf/layer.conf
```bitbake
# We have a conf directory, append to BBPATH
BBPATH .= ":${LAYERDIR}"

# We have a packages directory, add to BBFILES
BBFILES += "${LAYERDIR}/recipes/*/*.bb"

BBFILE_COLLECTIONS += "micro-layer"
BBFILE_PATTERN_micro-layer := "^${LAYERDIR}/"

# Define the priority for recipes (.bb files) from this layer,
# choosing carefully how this layer interacts with all of the
# other layers.
# 
# openembedded-layer is 6, we want to be above that.

BBFILE_PRIORITY_micro-layer = "10"
```
